## drivers/firmware/thead/Kconfig
```kconfig
# SPDX-License-Identifier: GPL-2.0-only
config TH1520_AON
	bool "Thead TH1520 Aon Protocol driver"
	depends on TH1520_MBOX
	default y
	help
	  Thead TH1520 Aon is a low-level system function which runs a dedicated
	  thead riscv E902 core to provide power, clock and resource management.

	  This driver manages the IPC interface between host cpu liks thead
	  and the Aon firmware running on thead riscv E902 core.

config TH1520_AON_PD
       bool "Thead TH1520 Aon Power Domain driver"
       depends on TH1520_AON
       help
	The Xuantie TH1520 Aon based power domain virtual driver.
	When selected, this option adds kernel support for dynamically
	configuring power to various peripherals and functional block.

        Note: Enabling this option requires the "Xuantie TH1520 Aon Support"
	(`TH1520_AON`) to be selected first, as this driver is built upon
	the foundational Aon infrastructure provided by that configuration.
```

## drivers/gpu/drm/img-rogue/Kconfig
```kconfig
config DRM_POWERVR_ROGUE
	tristate "PowerVR Rogue"
	depends on HAS_IOMEM
	depends on DRM
	select DRM_KMS_HELPER
	select PM_DEVFREQ
	select DEVFREQ_GOV_SIMPLE_ONDEMAND
	select PM_OPP
	select DEVFREQ_THERMAL
	select SYNC_FILE
	help
	  Driver for PowerVR Rogue graphics hardware.

	  Say Y here if your SoC contains a PowerVR Rogue GPU. For more
	  information, see <http://www.imgtec.com/powervr/>.

config DRM_POWERVR_ROGUE_DEBUG
	bool "Enable PowerVR Rogue debug features"
	depends on DRM_POWERVR_ROGUE
	default n
	help
	  Add additional debug features to the PowerVR Rogue driver.
	  To build a matching userspace, enable the following build options:
	  BUILD=debug SUPPORT_PAGE_FAULT_DEBUG=1 PVRSRV_ENABLE_GPU_MEMORY_INFO=1
```

## drivers/input/hall/Kconfig
```kconfig
# SPDX-License-Identifier: GPL-2.0
#
# hall  sensor drivers configuration
#


config HS_MH248
	tristate "hall sensor mh248"
```

## drivers/misc/hc32fx/Kconfig
```kconfig
# SPDX-License-Identifier: GPL-2.0-only

config MCU_HC32FX
	tristate "enable hc32fx mcu"
	depends on I2C
	help
		enable hc32fx mcu
```

## drivers/phy/synopsys/Kconfig
```kconfig
#SPDX-License-Identifier: GPL-2.0-only

config PHY_DW_DPHY
	tristate "Synopsys DesignWare MIPI D-PHY Support"
	depends on HAS_IOMEM && OF
	select GENERIC_PHY
	select GENERIC_PHY_MIPI_DPHY
	help
	  The dsi phy controller is between the LCD and dsi host controller.
	  For supporting LCD display, this config must be selected.

	  Choose this option if you have DesignWare D-PHY in your
	  system. If M is selected, the module will be called dw-dphy.
```

## drivers/soc/xuantie/Kconfig
```kconfig
# SPDX-License-Identifier: GPL-2.0-only
menu "XuanTie SoC drivers"

config TH1520_REBOOTMODE
	bool "XuanTie th1520 rebootmode support"
	depends on TH1520_AON
	default y
	help
	 This driver supports check rebootmode feature in TH1520 FM platform

config TH1520_SYSTEM_MONITOR
	bool "Xuantie th1520 system monitor"
	default y
	help
	 This driver supports system monitor feature in Th1520 FM platform

config TH1520_REGDUMP
	bool "XuanTie th1520 sysdump support"
	depends on TH1520_AON
	default y
	help
	 This driver supports sysdump feature in TH1520 FM platform

config TH1520_IOPMP
	tristate "Thead th1520 iopmp support"
	default y
	help
	  This driver supports TH1520 IOPMP built-in for security system

source "drivers/soc/xuantie/nna/Kconfig"
endmenu
```

## drivers/soc/xuantie/nna/Kconfig
```kconfig
menuconfig VHA
       tristate "IMG neural network accelerator"
       default m

if VHA
choice 
      prompt "VHA platform"
      config VHA_XUANTIE_TH1520
             bool "driver runs with XUANTIE TH1520 FM hw platform using a device tree."
             select HW_AX3
             select VHA_LO_PRI_SUBSEGS
      config VHA_XUANTIE_TH1520_FPGA_C910
             bool "driver runs with XUANTIE TH1520-FPGA hw platform using a device tree."
             select HW_AX3
      config VHA_DUMMY
             bool "driver runs without hardware."
             select HW_AX3
endchoice

config TARGET_OSID
      int
      default 0
config HW_AX3
      bool "driver runs AX31xx/AX33xx/AX35xx hardware."
      select VHA_MMU_MIRRORED_CTX
      select VHA_SYS_AURA
config VHA_MMU_MIRRORED_CTX
      bool "driver is compiled with mirrored MMU page tables regarding MODEL & IO."
      depends on HW_AX3
config VHA_SYS_AURA
      bool "driver runs with Aura system configuration file."
      depends on HW_AX3
config VHA_LO_PRI_SUBSEGS
      bool "driver is compiled to support low priority subsegments"
      depends on HW_AX3
endif
```

## drivers/video/lt8911exb/Kconfig
```kconfig
config ROCKCHIP_LT8911EXB
	tristate "techvision LT8911EXB driver on ROCKCHIP platform"
	default y
	help
	  rockchip LT8911EXB module. MIPI to EDP
```

## sound/soc/xuantie/Kconfig
```kconfig
# SPDX-License-Identifier: GPL-2.0-only
config SND_SOC_XUANTIE
        tristate "ASoC support for XUANTIE"
	depends on ARCH_XUANTIE
	default n
	    help
	      Say Y or M if you want to add support for codecs attached to
	      the XUANTIE SoCs' Audio interfaces. You will also need to
	      select the audio interfaces to support below.

config SND_SOC_XUANTIE_TH1520_I2S
        tristate "XuanTie TH1520 2-Channel I2S audio Support"
	depends on SND_SOC_XUANTIE
	select SND_SOC_GENERIC_DMAENGINE_PCM
	default n
        help
          Say Y or M if you want to add support for codecs attached to the
          XuanTie TH1520 interface

config SND_SOC_XUANTIE_TH1520_I2S_CH8
        tristate "XuanTie TH1520 8-Channel I2S audio Support"
	depends on SND_SOC_XUANTIE
	select SND_SOC_GENERIC_DMAENGINE_PCM
	default n
        help
          Say Y or M if you want to add support for codecs attached to the
          XuanTie TH1520 interface

config SND_SOC_XUANTIE_TH1520_HDMI_PCM
        tristate "XuanTie TH1520 HDMI PCM audio Support"
	depends on SND_SOC_XUANTIE
	default n
        help
          Say Y or M if you want to add support for HDMI PCM to the XuanTie
          TH1520 interface

config SND_SOC_XUANTIE_TH1520_TDM
        tristate "XuanTie TH1520 audio tdm feature Support"
	depends on SND_SOC_XUANTIE
	select SND_SOC_GENERIC_DMAENGINE_PCM
	default n
        help
          Say Y or M if you want to add support for codecs attached to the
          XuanTie TH1520 interface
```

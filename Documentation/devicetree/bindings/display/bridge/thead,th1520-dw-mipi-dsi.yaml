## Documentation/devicetree/bindings/display/bridge/thead,th1520-dw-mipi-dsi.yaml
```yaml
# SPDX-License-Identifier: (GPL-2.0-only OR BSD-2-Clause)
%YAML 1.2
---
$id: http://devicetree.org/schemas/display/bridge/thead,th1520-dw-mipi-dsi.yaml#
$schema: http://devicetree.org/meta-schemas/core.yaml#

title: T-Head TH1520 DesignWare MIPI DSI Host Controller

maintainers:
  - Icenowy Zheng <zhengxingda@iscas.ac.cn>

description:
  The MIPI DSI host controller in TH1520 is a Synopsys DesignWare MIPI DSI
  host controller paired with an integrated Synopsys MIPI D-PHY.

allOf:
  - $ref: snps,dw-mipi-dsi.yaml#

properties:
  compatible:
    const: thead,th1520-dw-mipi-dsi

  interrupts:
    maxItems: 1

  clocks:
    items:
      - description: DSI controller APB clock
      - description: PHY configuration clock
      - description: PHY reference clock
      - description: DSI controller input pixel clock gate

  clock-names:
    items:
      - const: pclk
      - const: phy_cfg
      - const: ref
      - const: pixel

  syscon:
    $ref: /schemas/types.yaml#/definitions/phandle
    description:
      Phandle to the VO subsystem system controller.

required:
  - compatible
  - reg
  - clocks
  - clock-names
  - resets
  - reset-names
  - interrupts
  - syscon
  - ports

unevaluatedProperties: false

examples:
  - |
    #include <dt-bindings/clock/thead,th1520-clk-ap.h>
    #include <dt-bindings/interrupt-controller/irq.h>
    #include <dt-bindings/reset/thead,th1520-reset.h>

    soc {
      #address-cells = <2>;
      #size-cells = <2>;

      dsi0: dsi@ffef500000 {
        compatible = "thead,th1520-dw-mipi-dsi";
        reg = <0xff 0xef500000 0x0 0x1000>;
        interrupts = <119 IRQ_TYPE_LEVEL_HIGH>;
        clocks = <&clk_vo CLK_MIPI_DSI0_PCLK>,
                 <&clk_vo CLK_MIPI_DSI0_CFG>,
                 <&clk_vo CLK_MIPI_DSI0_REFCLK>,
                 <&clk_vo CLK_MIPIDSI0_PIXCLK>;
        clock-names = "pclk", "phy_cfg", "ref", "pixel";
        resets = <&rst TH1520_RESET_ID_DSI0_APB>;
        reset-names = "apb";
        syscon = <&syscon_vo>;

        ports {
          #address-cells = <1>;
          #size-cells = <0>;

          port@0 {
            reg = <0>;

            dsi0_in: endpoint {
              remote-endpoint = <&dpu_out_dpi0>;
            };
          };

          dsi0_out_port: port@1 {
            reg = <1>;

            dsi0_out_panel: endpoint {
              remote-endpoint = <&panel_in>;
            };
          };
        };
      };
    };
```

## Documentation/devicetree/bindings/phy/thead,th1520-usb-phy.yaml
```yaml
# SPDX-License-Identifier: (GPL-2.0-only OR BSD-2-Clause)
%YAML 1.2
---
$id: http://devicetree.org/schemas/phy/thead,th1520-usb-phy.yaml#
$schema: http://devicetree.org/meta-schemas/core.yaml#

title: T-Head TH1520 USB PHY

description: |
  The T-HEAD TH1520 USB PHY is a Synopsys USB 3.0 FemtoPHY glued with some
  custom logic to configure PHY parameters.

maintainers:
  - Icenowy Zheng <zhengxingda@iscas.ac.cn>
  - Wei Fu <wefu@redhat.com>
  - Drew Fustini <dfustini@tenstorrent.com>

properties:
  compatible:
    const: thead,th1520-usb-phy

  reg:
    maxItems: 1

  "#phy-cells":
    const: 0

  clocks:
    items:
      - description: PHY bus clock
      - description: PHY reference clock

  clock-names:
    items:
      - const: bus
      - const: ref

  resets:
    items:
      - description: PHY bus reset
      - description: PHY reset

  reset-names:
    items:
      - const: bus
      - const: phy

  avdd33-usb3-supply:
    description: |
      3.3V power supply for the PHY, named AVDD33_USB3 in the SoC pin list.

required:
  - compatible
  - "#phy-cells"
  - clocks
  - clock-names
  - resets
  - reset-names
  - avdd33-usb3-supply

additionalProperties: false

examples:
  - |
    phy@ec030000 {
      compatible = "thead,th1520-usb-phy";
      reg = <0xec030000 0x10000>;
      #phy-cells = <0>;
      clocks = <&clk_misc 1>, <&clk_misc 3>;
      clock-names = "bus", "ref";
      resets = <&rst_misc 6>, <&rst_misc 7>;
      reset-names = "bus", "phy";
      avdd33-usb3-supply = <&avdd33_usb3>;
    };
```

## Documentation/devicetree/bindings/soc/thead/thead,th1520-syscon.yaml
```yaml
# SPDX-License-Identifier: (GPL-2.0 OR BSD-2-Clause)
%YAML 1.2
---
$id: http://devicetree.org/schemas/soc/thead/thead,th1520-syscon.yaml#
$schema: http://devicetree.org/meta-schemas/core.yaml#

title: T-HEAD TH1520 SoC System Controller

description: |
  The T-HEAD TH1520 SoC contains multiple system controllers providing
  access to miscellaneous registers, for sideband signal configuration or
  debugging.

  See the SoC system user manual at
  https://openbeagle.org/beaglev-ahead/beaglev-ahead/-/blob/main/docs/TH1520%20System%20User%20Manual.pdf

maintainers:
  - Icenowy Zheng <zhengxingda@iscas.ac.cn>
  - Wei Fu <wefu@redhat.com>
  - Drew Fustini <dfustini@tenstorrent.com>

properties:
  compatible:
    items:
      - enum:
          - thead,th1520-syscon-ao
          - thead,th1520-syscon-ap
          - thead,th1520-syscon-dsp
          - thead,th1520-syscon-misc
          - thead,th1520-syscon-vo
          - thead,th1520-syscon-vi
          - thead,th1520-syscon-vp
      - const: syscon

  reg:
    maxItems: 1

required:
  - compatible
  - reg

additionalProperties: false

examples:
  - |
    soc {
      #address-cells = <2>;
      #size-cells = <2>;

      sysconff@ef018000 {
          compatible = "thead,th1520-syscon-ap", "syscon";
          reg = <0xff 0xef018000 0x0 0x1000>;
      };
    };

...
```

## drivers/phy/thead/Kconfig
```kconfig
# SPDX-License-Identifier: GPL-2.0-only
config PHY_TH1520_USB
	tristate "USB PHY driver for T-Head TH1520 SoC"
	depends on ARCH_THEAD || COMPILE_TEST
	depends on COMMON_CLK
	depends on HAS_IOMEM
	depends on OF
	depends on RESET_CONTROLLER
	select GENERIC_PHY
	select REGMAP_MMIO
	help
	  Enable support for the USB PHY on the T-Head TH1520 SoC.
```

## drivers/soc/thead/Kconfig
```kconfig
# SPDX-License-Identifier: GPL-2.0-only
menu "XuanTie SoC drivers"

config TH1520_REBOOTMODE
	bool "XuanTie th1520 rebootmode support"
	depends on TH1520_AON_PROTOCOL
	default n
	help
	 This driver supports check rebootmode feature in TH1520

endmenu
```

## Documentation/devicetree/bindings/hwlock/xuantie,th1520-hwspinlock.yaml
```yaml
# SPDX-License-Identifier: (GPL-2.0-only OR BSD-2-Clause)
%YAML 1.2
---
$id: http://devicetree.org/schemas/hwlock/xuantie,th1520-hwspinlock.yaml#
$schema: http://devicetree.org/meta-schemas/core.yaml#

title: XUANTIE th1520 SoC HwSpinlock

maintainers:
  - Liu Yibin <jiulong@linux.alibaba.com>

properties:
  compatible:
    items:
      - const: th1520,hwspinlock

  reg:
    maxItems: 1


required:
  - compatible
  - reg

additionalProperties: false

examples:

  - |
    hwspinlock: hwspinlock@ffefc10000 {
        compatible = "th1520,hwspinlock";
        reg = <0xff 0xefc10000 0x0 0x10000>;
        status = "disabled";
    };
```

## Documentation/devicetree/bindings/iio/adc/thead,th1520-adc.yaml
```yaml
# SPDX-License-Identifier: (GPL-2.0-only OR BSD-2-Clause)
%YAML 1.2
---
$id: http://devicetree.org/schemas/iio/adc/thead,th1520-adc.yaml#
$schema: http://devicetree.org/meta-schemas/core.yaml#

title: THEAD TH1520 Analog to Digital Converter (ADC)

maintainers:
  - Fugang Duan <duanfugang.dfg@linux.alibaba.com>
  - Xiangyi Zeng <xiangyi.zeng@linux.alibaba.com>
  - Wei Fu <wefu@redhat.com>

description: |
  12-Bit Analog to Digital Converter (ADC) on XuanTie TH1520
properties:
  compatible:
    const: thead,th1520

  reg:
    maxItems: 1

  interrupts:
    maxItems: 1

  clocks:
    maxItems: 1

  clock-names:
    const: adc

required:
  - compatible
  - reg
  - interrupts
  - clocks
  - clock-names
  - status

additionalProperties: false

examples:
  - |
    adc: adc@0xfffff51000 {
        compatible = "thead,th1520-adc";
        reg = <0xff 0xfff51000 0x0 0x1000>;
        interrupts = <61 IRQ_TYPE_LEVEL_HIGH>;
        clocks = <&aonsys_clk>;
        clock-names = "adc";
        /* ADC pin is proprietary,no need to config pinctrl */
        status = "disabled";
    };
```

## Documentation/devicetree/bindings/mailbox/xuantie-th1520-mailbox.txt
```
XuanTie TH1520 mailbox controller
--------------------------------------------------------------------

The XuanTie TH1520 mailbox controller enables two cores within the SoC to
communicate and coordinate by passing messages (e.g. data, status
and control) through the mailbox chan. It also provides the ability
for one core to signal the other processor using interrupts.

TH1520 mailbox Device Node:
=============================

Required properties:
-------------------
- compatible :	Should be "xuantie,th1520-mbox".
- reg :		Should contain the registers location and length
- interrupts :	Interrupt number. The interrupt specifier format depends
		on the interrupt controller parent.
- icu_cpu_id :  Should be the ICU CPU ID defined in SOC.
- #mbox-cells:  Must be 2.
			  <&phandle type channel>
			    phandle	: Label name of controller
			    channel	: Channel number
			    type	: Channel type

		This TH1520 mailbox support 4 channels and 2 types.
		channel supported:
			support 4 channels: 0,1,2,3

		types supported:
			0 - TX & RX channel share the same channel with 7 info registers to
			    share data, and with IRQ support.
			1 - TX & RX doorbell channel. Without own info registers and no ACK support.

Optional properties:
-------------------
- clocks :	phandle to the input clock.

Examples:
--------
mbox_910t: mbox@ffffc38000 {
  compatible = "xuantie,th1520-mbox";
  reg = <0xff 0xffc38000 0x0 0x4000>,
        <0xff 0xffc44000 0x0 0x1000>,
        <0xff 0xffc4c000 0x0 0x1000>,
        <0xff 0xffc54000 0x0 0x1000>;
  reg-names = "local_base",
        "remote_icu0",
        "remote_icu1",
        "remote_icu2";
  interrupt-parent = <&intc>;
  interrupts = <28>;
  clocks = <&dummy_clock_apb>;
  clock-names = "ipg";
  icu_cpu_id = <0>;
  #mbox-cells = <2>;
};
```

## Documentation/devicetree/bindings/misc/xuantie,iso7816-smart-card.txt
```
= XUANTIE TH1520 dcd smart card which complies with ISO7816 protocol msic device tree bindings =

This binding is intended to represent TH1520-ISO7816 DCD SMART CARD which is found in XUANTIE SoCs

Required properties:
- compatible:	should be
		"xuantie,th1520-fm-efuse": for th1520 fullmask
- reg:	should contain registers location and length
- interrupts:	the interrupt number for this device
- interrupt-parent:	the interrupt controller to manage this device interrupt

Example:

	iso7816: iso7816-card@fff7f30000 {
		compatible = "xuantie,th1520-iso7816-card";
		reg = <0xff 0xf7f30000 0x0 0x4000>;
		interrupts = <69 IRQ_TYPE_LEVEL_HIGH>;
		status = "disabled";
	};
```

## Documentation/devicetree/bindings/net/thead,dwmac.yaml
```yaml
# SPDX-License-Identifier: (GPL-2.0-only OR BSD-2-Clause)
%YAML 1.2
---
$id: http://devicetree.org/schemas/net/thead,dwmac.yaml#
$schema: http://devicetree.org/meta-schemas/core.yaml#

title: T-HEAD DWMAC Ethernet controller

maintainers:
  - Jisheng Zhang <jszhang@kernel.org>

select:
  properties:
    compatible:
      contains:
        enum:
          - thead,th1520-dwmac
  required:
    - compatible

properties:
  compatible:
    items:
      - enum:
          - thead,th1520-dwmac
      - const: snps,dwmac-3.70a

  reg:
    maxItems: 1

  thead,gmacapb:
    $ref: /schemas/types.yaml#/definitions/phandle
    description:
      The phandle to the syscon node that control ethernet
      interface and timing delay.

required:
  - compatible
  - reg
  - clocks
  - clock-names
  - interrupts
  - interrupt-names
  - phy-mode
  - thead,gmacapb

allOf:
  - $ref: snps,dwmac.yaml#

unevaluatedProperties: false

examples:
  - |
    gmac0: ethernet@e7070000 {
        compatible = "thead,th1520-dwmac", "snps,dwmac-3.70a";
        reg = <0xe7070000 0x2000>;
        clocks = <&clk 1>, <&clk 2>;
        clock-names = "stmmaceth", "pclk";
        interrupts = <66>;
        interrupt-names = "macirq";
        phy-mode = "rgmii-id";
        snps,fixed-burst;
        snps,axi-config = <&stmmac_axi_setup>;
        snps,pbl = <32>;
        thead,gmacapb = <&gmacapb_syscon>;
        phy-handle = <&phy0>;

        mdio {
            #address-cells = <1>;
            #size-cells = <0>;
            compatible = "snps,dwmac-mdio";

            phy0: ethernet-phy@0 {
                reg = <0>;
            };
        };
    };
```

## Documentation/devicetree/bindings/nvmem/xuantie,th1520-efuse.txt
```
= XuanTie TH1520-EFUSE device tree bindings =

This binding is intended to represent TH1520-EFUSE which is found in XuanTie
SoCs

Required properties:
- compatible:	should be
		"xuantie,th1520-efuse": for th1520 fullmask
- reg:	should contain registers location and length
- xuantie,secsys: the syscon phandle to read and write sec system registers

Example:

	nvmem_controller: efuse@ffff210000 {
		compatible = "xuantie,th1520-efuse";
		reg = <0xff 0xff210000 0x0 0x10000>;
		xuantie,secsys = <&secsys_reg>;
	};
```

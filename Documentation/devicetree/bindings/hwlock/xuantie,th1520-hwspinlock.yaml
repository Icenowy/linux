## Documentation/devicetree/bindings/soc/xuantie/xuantie,th1520-event.yaml
```yaml
# SPDX-License-Identifier: (GPL-2.0 OR BSD-2-Clause)
%YAML 1.2
---
$id: http://devicetree.org/schemas/soc/xuantie/xuantie,th1520-event.yaml#
$schema: http://devicetree.org/meta-schemas/core.yaml#

title: XuanTie TH1520 SOC Rebootmode Feature

maintainers:
  - Hao Li <ben.lihao@linux.alibaba.com>
  - Xiangyi Zeng <xiangyi.zeng@linux.alibaba.com>

description:
  This driver supports check rebootmode feature in th1520 FM platform.
  When the system reboots, event driver recording the reboot cause to a
  piece of always-on ram, which is data-hold during the system reboot.

properties:
  compatible:
      - items:
          - const: xuantie,th1520-event

  aon-iram-regmap:
    description:
      always-on ram address range for driver to save rebootmode

required:
  - compatible
  - aon-iram-regmap

examples:
  - |
    th1520_event: th1520-event {
        compatible = "xuantie,th1520-event";
        aon-iram-regmap = <&aon_iram>;
        status = "okay";
    };
```

## Documentation/devicetree/bindings/sound/everest,es7210.txt
```
ES7210 i2s DA converter

Required properties:
- compatible : "everest,es7210" or
- VDD-supply : regulator phandle for the VDD supply
- PVDD-supply: regulator phandle for the PVDD supply for the es7210

Example:
i2s_codec: external-codec {
	compatible = "everest,es7210";
	VDD-supply = <&vcc_5v>;
};
```

## Documentation/devicetree/bindings/sound/everest,es8156.yaml
```yaml
# SPDX-License-Identifier: (GPL-2.0-only OR BSD-2-Clause)
%YAML 1.2
---
$id: http://devicetree.org/schemas/sound/everest,es8156.yaml#
$schema: http://devicetree.org/meta-schemas/core.yaml#

title: Everest ES8156 audio CODEC

maintainers:
  - shuofeng.ren <shuofeng.rsf@linux.alibaba.com>

allOf:
  - $ref: dai-common.yaml#

properties:
  compatible:
    const: everest,es8156

  reg:
    maxItems: 1

  "#sound-dai-cells":
    const: 0

required:
  - compatible
  - reg
  - "#sound-dai-cells"

unevaluatedProperties: false

examples:
  - |
    i2c {
      #address-cells = <1>;
      #size-cells = <0>;
      es8156: codec@8 {
        compatible = "everest,es8156";
        reg = <0x08>;
        #sound-dai-cells = <0>;
      };
    };
```

## Documentation/devicetree/bindings/sound/xuantie,th1520-i2s.yaml
```yaml
# SPDX-License-Identifier: GPL-2.0
%YAML 1.2
---
$id: http://devicetree.org/schemas/sound/xuantie,th1520-i2s.yaml#
$schema: http://devicetree.org/meta-schemas/core.yaml#

title: XuanTie Th1520 I2S controller

maintainers:
  - David Li <davidli.li@linux.alibaba.com>

properties:
  compatible:
    oneOf:
      - const: xuantie,th1520-i2s

  reg:
    maxItems: 1

  interrupts:
    maxItems: 1

  clocks:
    items:
      - description: clock for I2S controller

  clock-names:
    items:
      - const: i2s_pclk

  dmas:
    minItems: 1
    maxItems: 2

  dma-names:
    oneOf:
      - const: rx
      - items:
          - const: tx
          - const: rx

  pinctrl-names:
    oneOf:
      - const: default
      - items:
          - const: bclk
          - const: lrck
		  - const: dout
		  - const: din

  reset-names:
    items:
      - const: reset_i2s

  resets:
    maxItems: 1

  audio-cpr-regmap:
    description:
      The phandle of the syscon node for the CPR register.

  "#sound-dai-cells":
    const: 1

required:
  - compatible
  - reg
  - interrupts
  - clocks
  - clock-names
  - dmas
  - dma-names
  - resets
  - "#sound-dai-cells"

examples:
  - |
    i2s1: audio_i2s1@ffcb015000 {
        compatible = "xuantie,th1520-i2s";
        reg = <0xff 0xcb015000 0x0 0x1000>;
        pinctrl-names = "default";
        interrupts = <175, IRQ_TYPE_LEVEL_HIGH>;
        dmas = <&dmac2 11>, <&dmac2 10>;
        dma-names = "tx", "rx";
        #dma-cells = <1>;
        clocks = <&audiosys_clk_gate TH1520_CLKGEN_AUDIO_I2S1>;
        clock-names = "pclk";
        resets = <&audiosys_rst TH1520_RESET_AUD_I2S1>;
        xuantie,audio-cpr-regmap = <&audio_cpr>;
        #sound-dai-cells = <1>;
    };
```

## Documentation/devicetree/bindings/sound/xuantie,th1520-spdif.yaml
```yaml
# SPDX-License-Identifier: GPL-2.0
%YAML 1.2
---
$id: http://devicetree.org/schemas/sound/xuantie,th1520-spdif.yaml#
$schema: http://devicetree.org/meta-schemas/core.yaml#

title: TH1520 SPDIF transceiver

description:
  The S/PDIF audio block is a stereo transceiver that allows the
  processor to receive and transmit digital audio via a coaxial or
  fibre cable.

maintainers:
  - nanli.yd <nanli.yd@alibaba-inc.com>

properties:
  compatible:
    oneOf:
      - const: xuantie,th1520-spdif

  reg:
    maxItems: 1

  interrupts:
    maxItems: 1

  clocks:
    items:
      - description: clock for SPDIF controller

  clock-names:
    items:
      - const: pclk

  dmas:
    minItems: 1
    maxItems: 2

  dma-names:
    oneOf:
      - const: tx
      - items:
          - const: tx
          - const: rx

  audio-cpr-regmap:
    description:
      The phandle of the syscon node for the CPR register.

  "#sound-dai-cells":
    const: 0

required:
  - compatible
  - reg
  - interrupts
  - clocks
  - clock-names
  - dmas
  - dma-names
  - "#sound-dai-cells"

unevaluatedProperties: false

examples:
  - |
    spdif: spdif@ffcb018000 {
      compatible = "xuantie,th1520-spdif";
      reg = <0xff 0xcb018000 0x0 0x1000>;
      interrupts = <179 IRQ_TYPE_LEVEL_HIGH>;
      clocks = <&audiosys_clk_gate TH1520_CLKGEN_AUDIO_SPDIF0>;
      clock-names = "pclk";
      dmas = <&dmac2 25>, <&dmac2 24>;;
      dma-names = "tx", "rx";
      #sound-dai-cells = <0>;
    };
```

## Documentation/devicetree/bindings/sound/xuantie,th1520-tdm.yaml
```yaml
# SPDX-License-Identifier: (GPL-2.0-only OR BSD-2-Clause)
%YAML 1.2
---
$id: http://devicetree.org/schemas/sound/xuantie,th1520-tdm.yaml#
$schema: http://devicetree.org/meta-schemas/core.yaml#

title: TH1520 TDM Controller

description:
  The TH1520 TDM Controller is a Time Division Multiplexed
  audio interface in TH1520 SoCs, allowing up to 8 channels
  of audio over a serial interface.

maintainers:
  - nanli.yd <nanli.yd@alibaba-inc.com>

properties:
  compatible:
    enum:
      - xuantie,th1520-tdm

  reg:
    maxItems: 1

  interrupts:
    maxItems: 1

  dmas:
    maxItems: 1

  dma-names:
    maxItems: 1
    items:
      enum:
        - rx

  clocks:
    minItems: 1
    items:
      - description: tdm_pclk

  clock-names:
    minItems: 1
    items:
      - const: pclk

  resets:
    maxItems: 1
    description: reset tdm

  reset-names:
    maxItems: 1

  audio-cpr-regmap:
    description:
      The phandle of the syscon node for the CPR register.

  "#sound-dai-cells":
    const: 0

required:
  - compatible
  - reg
  - interrupts
  - dmas
  - dma-names
  - clocks
  - clock-names
  - resets
  - reset-names
  - "#sound-dai-cells"

examples:
  - |
    tdm: audio_tdm@ffcb012000 {
        compatible = "xuantie,th1520-tdm";
        reg = <0xff 0xcb012000 0x0 0x1000>;
        audio-cpr-regmap = <&audio_cpr>;
        interrupts = <178, IRQ_TYPE_LEVEL_HIGH>;
        dmas = <&dmac2 28>;
        dma-names = "rx";
        clocks = <&audiosys_clk_gate TH1520_CLKGEN_AUDIO_TDM>;
        clock-names = "pclk";
        resets = <&audiosys_rst TH1520_RESET_AUD_TDM>;
        #sound-dai-cells = <0>;
    };
```

## Documentation/devicetree/bindings/spi/thead,th1520-qspi.yaml
```yaml
# SPDX-License-Identifier: (GPL-2.0-only OR BSD-2-Clause)
%YAML 1.2
---
$id: http://devicetree.org/schemas/spi/thead,th1520-spi.yaml#
$schema: http://devicetree.org/meta-schemas/core.yaml#

title: THEAD TH1520 Quad Serial Peripheral Interface (QSPI)

maintainers:
  - linghui zeng<linghui.zlh@linux.alibaba.com>
  - Xiangyi Zeng <xiangyi.zeng@linux.alibaba.com>
properties:
  compatible:
    const: thead,th1520

  reg:
    maxItems: 1

  clocks:
    maxItems: 1

  clock-names:
    items:
      - const: sclk
      - const: pclk

  interrupts:
    maxItems: 1

required:
  - compatible
  - reg
  - clocks
  - clock-names
  - interrupts
  - status

unevaluatedProperties: false

examples:
  - |
    qspi0: qspi@ffea000000 {
        compatible = "snps,dw-apb-ssi-quad";
        reg = <0xff 0xea000000 0x0 0x1000>;
        interrupts = <52 IRQ_TYPE_LEVEL_HIGH>;
        clocks = <&clk CLKGEN_QSPI0_SSI_CLK>,
            <&clk CLKGEN_QSPI0_PCLK>;
        clock-names = "sclk", "pclk";
        #address-cells = <1>;
        #size-cells = <0>;
        status = "disabled";
    };
```

## Documentation/devicetree/bindings/spi/xuantie,th1520-spi.yaml
```yaml
# SPDX-License-Identifier: (GPL-2.0-only OR BSD-2-Clause)
%YAML 1.2
---
$id: http://devicetree.org/schemas/spi/xuantie,th1520-spi.yaml#
$schema: http://devicetree.org/meta-schemas/core.yaml#

title: XuanTie TH1520 SPI Controller

description: |
  The XuanTie TH1520 SPI controller is used to communicate with external devices using
  the Serial Peripheral Interface. It supports full-duplex, half-duplex and
  simplex synchronous serial communication with external devices. It supports
  from 4 to 32-bit data size.

maintainers:
  - linghui zeng <linghui.zlh@linux.alibaba.com>
  - Xiangyi Zeng <xiangyi.zeng@linux.alibaba.com>
properties:
  compatible:
    const: xuantie,th1520

  reg:
    maxItems: 1

  clocks:
    maxItems: 1

  clock-names:
    items:
      - const: sclk
      - const: pclk

  interrupts:
    maxItems: 1

required:
  - compatible
  - reg
  - clocks
  - clock-names
  - interrupts
  - status

additionalProperties: false

examples:
  - |
    spi: spi@ffe700c000 {
        compatible = "snps,dw-apb-ssi";
        reg = <0xff 0xe700c000 0x0 0x1000>;
        interrupts = <54 IRQ_TYPE_LEVEL_HIGH>;
        clocks = <&clk CLKGEN_SPI_SSI_CLK>,
            <&clk CLKGEN_SPI_PCLK>;
        clock-names = "sclk", "pclk";
        #address-cells = <1>;
        #size-cells = <0>;
        status = "disabled";
    };
```

## Documentation/devicetree/bindings/usb/thead,th1520-usb.yaml
```yaml
# SPDX-License-Identifier: (GPL-2.0-only OR BSD-2-Clause)
%YAML 1.2
---
$id: http://devicetree.org/schemas/usb/thead,th1520-usb.yaml#
$schema: http://devicetree.org/meta-schemas/core.yaml#

title: T-HEAD TH1520 DWC3 USB Controller Glue

maintainers:
  - Jisheng Zhang <jszhang@kernel.org>

properties:
  compatible:
    const: thead,th1520-usb

  reg:
    maxItems: 1

  clocks:
    maxItems: 4

  clock-names:
    items:
      - const: ref
      - const: bus_early
      - const: phy
      - const: suspend

  ranges: true

  '#address-cells':
    enum: [ 1, 2 ]

  '#size-cells':
    enum: [ 1, 2 ]

# Required child node:

patternProperties:
  "^usb@[0-9a-f]+$":
    $ref: snps,dwc3.yaml#

required:
  - compatible
  - reg
  - clocks
  - clock-names
  - ranges

additionalProperties: false

examples:
  - |

    usb {
          compatible = "thead,th1520-usb";
          reg = <0xec03f000 0x1000>;
          clocks = <&clk 1>,
                   <&clk 2>,
                   <&clk 3>,
                   <&clk 4>;
          clock-names = "ref", "bus_early", "phy", "suspend";
          ranges;
          #address-cells = <1>;
          #size-cells = <1>;

          usb@e7040000 {
                compatible = "snps,dwc3";
                reg = <0xe7040000 0x10000>;
                interrupts = <68>;
                dr_mode = "host";
          };
    };
```

## Documentation/devicetree/bindings/usb/xuantie,th1520-usb.yaml
```yaml
# SPDX-License-Identifier: (GPL-2.0-only OR BSD-2-Clause)
%YAML 1.2
---
$id: http://devicetree.org/schemas/usb/xuantie,th1520-usb.yaml#
$schema: http://devicetree.org/meta-schemas/core.yaml#

title: XuanTie TH1520 DWC3 USB Controller Glue

maintainers:
  - Jisheng Zhang <jszhang@kernel.org>

properties:
  compatible:
    const: xuantie,th1520-usb

  reg:
    maxItems: 1

  clocks:
    maxItems: 4

  clock-names:
    items:
      - const: ref
      - const: bus_early
      - const: phy
      - const: suspend

  ranges: true

  '#address-cells':
    enum: [ 1, 2 ]

  '#size-cells':
    enum: [ 1, 2 ]

# Required child node:

patternProperties:
  "^usb@[0-9a-f]+$":
    $ref: snps,dwc3.yaml#

required:
  - compatible
  - reg
  - clocks
  - clock-names
  - ranges

additionalProperties: false

examples:
  - |
		usb: usb@ffec03f000 {
			compatible = "xuantie,th1520-usb";
			usb3-misc-regmap = <&misc_sysreg>;
			reg = <0xff 0xec03f000 0x0 0x1000>;
			xuantie,misc-sysreg = <&misc_sysreg>;
			clocks = <&miscsys_clk_gate CLKGEN_MISCSYS_USB3_DRD_CLK>,
					<&miscsys_clk_gate CLKGEN_MISCSYS_USB3_DRD_CTRL_REF_CLK>,
					<&miscsys_clk_gate CLKGEN_MISCSYS_USB3_DRD_PHY_REF_CLK>,
					<&miscsys_clk_gate CLKGEN_MISCSYS_USB3_DRD_SUSPEND_CLK>;
			clock-names = "drd", "ctrl", "phy", "suspend";
			#address-cells = <2>;
			#size-cells = <2>;
			ranges;

			usb_dwc3: usb@ffe7040000 {
				compatible = "snps,dwc3";
				reg = <0xff 0xe7040000 0x0 0x10000>;
				interrupts = <68 IRQ_TYPE_LEVEL_HIGH>;
				dr_mode = "host";
				snps,usb3_lpm_capable;
				status = "disabled";
			};
		};
```
